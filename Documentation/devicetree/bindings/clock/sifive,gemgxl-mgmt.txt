## arch/riscv/Kconfig
```kconfig
#
# For a description of the syntax of this configuration file,
# see Documentation/kbuild/kconfig-language.txt.
#

config RISCV
	def_bool y
	select ARCH_HAS_ATOMIC64_DEC_IF_POSITIVE
	select ARCH_WANT_FRAME_POINTERS
	select CLONE_BACKWARDS
	select GENERIC_CLOCKEVENTS
	select GENERIC_CPU_DEVICES
	select GENERIC_IRQ_SHOW
	select GENERIC_STRNCPY_FROM_USER
	select GENERIC_STRNLEN_USER
	select GENERIC_SMP_IDLE_THREAD
	select GENERIC_ATOMIC64 if !64BIT || !RV_ATOMIC
	select HAVE_MEMBLOCK
	select HAVE_MEMBLOCK_NODE_MAP
	select RV_ATOMIC if SMP
	select RV_SYSRISCV_ATOMIC if !RV_ATOMIC
	select SYSCTL_EXCEPTION_TRACE
	select HAVE_ARCH_TRACEHOOK

config MMU
	def_bool y

config NO_DMA
	def_bool y

config STACKTRACE_SUPPORT
	def_bool y

config RWSEM_GENERIC_SPINLOCK
	def_bool y

config GENERIC_BUG
	def_bool y
	depends on BUG
	select GENERIC_BUG_RELATIVE_POINTERS if 64BIT

config GENERIC_BUG_RELATIVE_POINTERS
	bool

config GENERIC_CALIBRATE_DELAY
	def_bool y

config GENERIC_CSUM
	def_bool y

config GENERIC_HWEIGHT
	def_bool y

menu "Platform type"

config SMP
	bool "Symmetric Multi-Processing"
	help
	  This enables support for systems with more than one CPU.  If
	  you say N here, the kernel will run on single and
	  multiprocessor machines, but will use only one CPU of a
	  multiprocessor machine. If you say Y here, the kernel will run
	  on many, but not all, single processor machines. On a single
	  processor machine, the kernel will run faster if you say N
	  here.

	  If you don't know what to do here, say N.

config NR_CPUS
	int "Maximum number of CPUs (2-32)"
	range 2 32
	depends on SMP
	default "8"

choice
	prompt "CPU selection"
	default CPU_RV_ROCKET

config CPU_RV_ROCKET
	bool "Rocket"
	select CPU_SUPPORTS_64BIT_KERNEL

config CPU_RV_GENERIC
	bool "Generic RISC-V"
	select CPU_SUPPORTS_32BIT_KERNEL
	select CPU_SUPPORTS_64BIT_KERNEL

endchoice

config CPU_SUPPORTS_32BIT_KERNEL
	bool
config CPU_SUPPORTS_64BIT_KERNEL
	bool

config RVC
	bool "Use compressed instructions (RV32C or RV64C)"
	default n

config RV_ATOMIC
	bool "Use atomic memory instructions (RV32A or RV64A)"
	default y

config RV_SYSRISCV_ATOMIC
	bool "Include support for atomic operation syscalls"
	default n
	help
	  If atomic memory instructions are present, i.e.,
	  CONFIG_RV_ATOMIC, this includes support for the syscall that
	  provides atomic accesses.  This is only useful to run
	  binaries that require atomic access but were compiled with
	  -mno-atomic.

	  If CONFIG_RV_ATOMIC is unset, this option is mandatory.

source "arch/riscv/htif/Kconfig"

endmenu

menu "Kernel type"

choice
	prompt "Kernel code model"
	default 64BIT

config 32BIT
	bool "32-bit kernel"
	depends on CPU_SUPPORTS_32BIT_KERNEL
	help
	  Select this option to build a 32-bit kernel.

config 64BIT
	bool "64-bit kernel"
	depends on CPU_SUPPORTS_64BIT_KERNEL
	help
	  Select this option to build a 64-bit kernel.

endchoice

source "mm/Kconfig"

source "kernel/Kconfig.preempt"

source "kernel/Kconfig.hz"

endmenu

source "init/Kconfig"

source "kernel/Kconfig.freezer"

menu "Executable file formats"

source "fs/Kconfig.binfmt"

endmenu

menu "Power management options"

source kernel/power/Kconfig

endmenu

source "net/Kconfig"

source "drivers/Kconfig"

source "fs/Kconfig"

menu "Kernel hacking"

config CMDLINE_BOOL
	bool "Built-in kernel command line"
	default n
	help
	  For most platforms, it is firmware or second stage bootloader
	  that by default specifies the kernel command line options.
	  However, it might be necessary or advantageous to either override
	  the default kernel command line or add a few extra options to it.
	  For such cases, this option allows hardcoding command line options
	  directly into the kernel.

	  For that, choose 'Y' here and fill in the extra boot parameters
	  in CONFIG_CMDLINE.

	  The built-in options will be concatenated to the default command
	  line if CMDLINE_OVERRIDE is set to 'N'. Otherwise, the default
	  command line will be ignored and replaced by the built-in string.

config CMDLINE
	string "Built-in kernel command string"
	depends on CMDLINE_BOOL
	default ""
	help
	  Supply command-line options at build time by entering them here.

config CMDLINE_OVERRIDE
	bool "Built-in command line overrides bootloader arguments"
	default n
	depends on CMDLINE_BOOL
	help
	  Set this option to 'Y' to have the kernel ignore the bootloader
	  or firmware command line.  Instead, the built-in command line
	  will be used exclusively.

config EARLY_PRINTK
	bool "Early printk"
	default n
	help
	  This option enables special console drivers which allow the kernel
	  to print messages very early in the bootup process.

	  This is useful for kernel debugging when your machine crashes very
	  early before the console code is initialized. For normal operation
	  it is not recommended because it looks ugly and doesn't cooperate
	  with klogd/syslogd or the X server. You should normally N here,
	  unless you want to debug such a crash.


source "lib/Kconfig.debug"

config CMDLINE_BOOL
	bool 
endmenu

source "security/Kconfig"

source "crypto/Kconfig"

source "lib/Kconfig"
```

## arch/riscv/configs/freedom-u500_defconfig
```kconfig
CONFIG_DEFAULT_HOSTNAME="ucbvax"
# CONFIG_CROSS_MEMORY_ATTACH is not set
# CONFIG_FHANDLE is not set
CONFIG_NAMESPACES=y
# CONFIG_SGETMASK_SYSCALL is not set
CONFIG_EMBEDDED=y
# CONFIG_BLK_DEV_BSG is not set
CONFIG_PARTITION_ADVANCED=y
# CONFIG_EFI_PARTITION is not set
# CONFIG_IOSCHED_DEADLINE is not set
# CONFIG_COMPACTION is not set
CONFIG_HZ_100=y
CONFIG_PCI_MSI=y
CONFIG_NET=y
CONFIG_UNIX=y
CONFIG_INET=y
# CONFIG_INET_XFRM_MODE_TRANSPORT is not set
# CONFIG_INET_XFRM_MODE_TUNNEL is not set
# CONFIG_INET_XFRM_MODE_BEET is not set
# CONFIG_INET_DIAG is not set
# CONFIG_IPV6 is not set
# CONFIG_WIRELESS is not set
CONFIG_DEVTMPFS=y
CONFIG_DEVTMPFS_MOUNT=y
# CONFIG_FIRMWARE_IN_KERNEL is not set
CONFIG_OF=y
# CONFIG_BLK_DEV is not set
# CONFIG_INPUT_KEYBOARD is not set
# CONFIG_INPUT_MOUSE is not set
# CONFIG_VT is not set
CONFIG_DEVKMEM=y
# CONFIG_HW_RANDOM is not set
# CONFIG_HWMON is not set
CONFIG_FB=y
# CONFIG_USB_SUPPORT is not set
# CONFIG_IOMMU_SUPPORT is not set
CONFIG_EXT2_FS=y
# CONFIG_FILE_LOCKING is not set
# CONFIG_DNOTIFY is not set
# CONFIG_INOTIFY_USER is not set
# CONFIG_PROC_PAGE_MONITOR is not set
# CONFIG_SYSFS is not set
CONFIG_TMPFS=y
# CONFIG_MISC_FILESYSTEMS is not set
# CONFIG_NETWORK_FILESYSTEMS is not set
CONFIG_PRINTK_TIME=y
# CONFIG_UNUSED_SYMBOLS is not set
CONFIG_DEBUG_SECTION_MISMATCH=y
# CONFIG_FRAME_POINTER is not set
# CONFIG_EARLY_PRINTK is not set
# CONFIG_CRYPTO_HW is not set
CONFIG_TTY=y
```

## arch/riscv/drivers/Kconfig
```kconfig
config CONFIG_STRING
	bool "Platform device config-string parser"
	depends on RISCV
	default y
	help
	   This enables support for reading and parsing the configuration
	   string typically found on RISC-V systems. The string describes
	   devices included in the on-board SoC. Without this option, any
	   devices described in the config string will not be loaded.

	   Say 'Y' here if you have a standard RISC-V platform.

config PLIC
	bool "Platform-Level Interrupt Controller"
	depends on CONFIG_STRING
	default y
	help
	   This enables support for the PLIC chip found in standard RISC-V
	   systems. The PLIC is the top-most interrupt controller found in
	   the system, connected directly to the core complex. All other
	   interrupt sources (MSI, GPIO, etc) are subordinate to the PLIC.

	   If you don't know what to do here, say Y.

config GPIO_RV
	bool "Onboard GPIO support for RV"
	depends on CONFIG_STRING
	default y
	select GPIOLIB
	select GPIO_SYSFS
	help
	  This enables support for platform GPIO devices.

	  Say 'Y' here if you want the kernel to support LEDs.

config PCIE_XILINX_RV
	bool "Xilinx AXI PCIe host bridge support fo RV"
	depends on RISCV
	select PCI
	help
	  Say 'Y' here if you want kernel to support the Xilinx AXI PCIe
	  Host Bridge driver.
```

## arch/riscv/htif/Kconfig
```kconfig
menuconfig HTIF
	bool "HTIF"
	depends on 64BIT
	default y
	help
	  Host-Target Interface

if HTIF

config HTIF_BLOCK
	tristate "HTIF block device support"
	select BLOCK
	default y

config HTIF_RFB
	tristate "HTIF remote framebuffer support"
	select FB
	select FB_CFB_FILLRECT
	select FB_CFB_COPYAREA
	select FB_CFB_IMAGEBLIT
	default n

endif # HTIF
```

## arch/riscv/platform/Kconfig
```kconfig
menu "IP cores"

config RISCV_TEMAC
	tristate "Xilinx TEMAC support"
	default n
	depends on NETDEVICES
	depends on ETHERNET

if RISCV_TEMAC

config RISCV_TEMAC_CSR_CFGA
	hex "TEMAC configuration address CSR"
	default 0x520

config RISCV_TEMAC_CSR_CFGD
	hex "TEMAC configuration value CSR"
	default 0x521

endif # RISCV_TEMAC

endmenu
```

## drivers/clk/sifive/Kconfig
```kconfig
config CLK_U54_PRCI
	bool "PRCI driver for U54 SoCs"
	depends on RISCV
	---help---
	  Supports Power Reset Clock interface found in U540 SoCs
```
