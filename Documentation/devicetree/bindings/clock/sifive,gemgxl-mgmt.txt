## Documentation/devicetree/bindings/clock/sifive,gemgxl-mgmt.txt
```
TX clock switch for GEMGXL in U540 SoCs

This binding uses the common clock binding:
    Documentation/devicetree/bindings/clock/clock-bindings.txt

The U54 includes a clock mux to control the ethernet TX frequenecy. It
switches between the local TX clock (125MHz) and PHY TX clocks. This is
necessary to toggle between 1Gb and 100/10Mb speeds.

Required properties:
- compatible:	Should be "sifive,cadencegemgxlmgmt0"
- #clock-cells:	Should be <0>
- reg:		Specifies base physical address and size of the registers

Example:

	mgmt: cadence-gemgxl-mgmt@100a00000 {
		compatible = "sifive,cadencegemgxlmgmt0";
		#clock-cells = <0>;
		reg = <0x0 0x100a0000 0x0 0x1000>;
	};

	ethernet@10090000 {
		...
		clocks = <&mgmt>; /* TX clock */
	};
```

## Documentation/devicetree/bindings/clock/sifive,u54-prci.txt
```
SiFive U54 SoC clocks

This binding uses the common clock binding:
    Documentation/devicetree/bindings/clock/clock-bindings.txt

The U54 PRCI controller generates clocks for the U54 SoC. There is
a core PLL that sets the processor frequency and PLLs for ethernet
and DDR. It takes an input clock from the board, typically an oscillator
or crystal.

Required properties:
- compatible:	Should be "sifive,aloeprci0"
- #clock-cells:	Should be <1>
- reg:		Specifies base physical address and size of the registers
- clocks:	phandles to the parent clock used as input

Example:

	refclk: refclk {
		#clock-cells = <0>;
		compatible = "fixed-clock";
		clock-frequency = <33333333>;
		clock-output-names = "xtal";
	};

	u54: prci@10000000 {
		compatible = "sifive,aloeprci0";
		reg = <0x0 0x10000000 0x0 0x1000>;
		clocks = <&refclk>;
		#clock-cells = <1>;
	};

	tlclk: tlclk {
		compatible = "fixed-factor-clock";
		clocks = <&u54 0>; /* Core frequency */
		#clock-cells = <0>;
		clock-div = <2>;
		clock-mult = <1>;
	};

	ethernet@10090000 {
		...
		clocks = <&prci 1>; /* TX clock */
	};
```

## Documentation/devicetree/bindings/firmware/riscv,sbi.txt
```
RISC-V Supervisor Binary Interface (SBI)

The RISC-V privileged ISA specification mandates the presence of a supervisor
binary interface that performs some operations which might otherwise require
particularly complicated instructions.  This interface includes
inter-processor interrupts, TLB flushes, i-cache and TLB shootdowns, a
console, and power management.

Required properties:
- compatible: must contain one of the following
 * "riscv,sbi" for the SBI defined by the privileged specification of the
   system.

Example:

firmware {
	sbi {
		compatible = "riscv,sbi";
	};
};
```

## Documentation/devicetree/bindings/gpio/gpio-sifive.txt
```
SiFive GPIO controller bindings

Required properties:
- compatible:
  - "sifive,gpio0"
- reg: Physical base address and length of the controller's registers.
- #gpio-cells : Should be 2
  - The first cell is the gpio offset number.
  - The second cell indicates the polarity of the GPIO
- gpio-controller : Marks the device node as a GPIO controller.
- interrupt-controller: Mark the device node as an interrupt controller
- #interrupt-cells : Should be 2.
  - The first cell is the GPIO offset number within the GPIO controller.
  - The second cell is the edge/level to use for interrupt generation.
- interrupts: Specify the interrupts, one per GPIO

Example:

gpio: gpio@10060000 {
	compatible = "sifive,gpio0";
	interrupt-parent = <&plic>;
	interrupts = <7 8 9 10 11 12 13 14 15 16 17 18 19 20 21 22>;
	reg = <0x0 0x10060000 0x0 0x1000>;
	gpio-controller;
	#gpio-cells = <2>;
	interrupt-controller;
	#interrupt-cells = <2>;
};
```

## Documentation/devicetree/bindings/interrupt-controller/riscv,cpu-intc.txt
```
RISC-V Hart-Level Interrupt Controller (HLIC)
---------------------------------------------

RISC-V cores include Control Status Registers (CSRs) which are local to each
hart and can be read or written by software. Some of these CSRs are used to
control local interrupts connected to the core.  Every interrupt is ultimately
routed through a hart's HLIC before it interrupts that hart.

The RISC-V supervisor ISA manual specifices three interrupt sources that are
attached to every HLIC: software interrupts, the timer interrupt, and external
interrupts.  Software interrupts are used to send IPIs between cores.  The
timer interrupt comes from an architectually mandated real-time timer that is
controller via SBI calls and CSR reads.  External interrupts connect all other
device interrupts to the HLIC, which are routed via the platforw-level
interrupt contrellor (PLIC).

All RISC-V systems that conform to the supervisor ISA specification are
required to have a HLIC with these three interrupt sources present.

Required properties:
- compatible : "riscv,cpu-intc"
- #interrupt-cells : should be <1>
- interrupt-controller : Identifies the node as an interrupt controller

Furthermore, this interrupt-controller MUST be embedded inside the cpu
definition of the hart whose CSRs control these local interrupts.

An example of a device tree entry for a standard RISC-V hart is as follows:

	cpu1: cpu@1 {
		clock-frequency = <1600000000>;
		compatible = "riscv";
		d-cache-block-size = <64>;
		d-cache-sets = <64>;
		d-cache-size = <16384>;
		d-tlb-sets = <1>;
		d-tlb-size = <32>;
		device_type = "cpu";
		i-cache-block-size = <64>;
		i-cache-sets = <64>;
		i-cache-size = <16384>;
		i-tlb-sets = <1>;
		i-tlb-size = <32>;
		mmu-type = "riscv,sv39";
		next-level-cache = <&L2>;
		reg = <1>;
		riscv,isa = "rv64imac";
		status = "okay";
		tlb-split;
		cpu1-intc: interrupt-controller {
			#interrupt-cells = <1>;
			compatible = "riscv,cpu-intc";
			interrupt-controller;
		};
	};

The sections specifically relevant to the HLIC are

	cpu1: cpu@1 {
		cpu1-intc: interrupt-controller {
			#interrupt-cells = <1>;
			compatible = "riscv,cpu-intc";
			interrupt-controller;
		};
	};

As the HLIC is essentially a static interrupt controller, this device tree
entry essentially just indicates the presence of a HLIC.  All HLIC interrupts
are level-triggered, so there is no need to specify this as part of the device
tree.
```

## Documentation/devicetree/bindings/interrupt-controller/riscv,plic0.txt
```
RISC-V Platform-Level Interrupt Controller (PLIC)
-------------------------------------------------

The RISC-V supervisor ISA specification allows for the presence of a
platform-level interrupt controller (PLIC).   The PLIC connects all external
interrupts in the system to all hart contexts in the system, via the external
interrupt source in each hart's hart-local interrupt controller (HLIC).  A hart
context is a privilege mode in a hardware execution thread.  For example, in
an 4 core system with 2-way SMT, you have 8 harts and probably at least two
privilege modes per hart; machine mode and supervisor mode.

Each interrupt can be enabled on per-context basis. Any context can claim
a pending enabled interrupt and then release it once it has been handled.

Each interrupt has a configurable priority. Higher priority interrupts are
serviced firs. Each context can specify a priority threshold. Interrupts
with priority below this threshold will not cause the PLIC to raise its
interrupt line leading to the context.

While the PLIC supports both edge-triggered and level-triggered interrupts,
interrupt handlers are oblivious to this distinction and therefor it is not
specific in the PLIC device-tree binding.

While the RISC-V ISA doesn't specify a memory layout for the PLIC, the
"riscv,plic0" device is a concrete implementation of the PLIC that contains a
specific memory layout.  More details about the memory layout of the
"riscv,plic0" device can be found as a comment in the device driver, or as part
of the SiFive U5 Coreplex Series Manual (page 22 of the PDF of version 1.0)
<https://www.sifive.com/documentation/coreplex/u5-coreplex-series-manual/>

Required properties:
- compatible : "riscv,plic0"
- #address-cells : should be <0>
- #interrupt-cells : should be <1>
- interrupt-controller : Identifies the node as an interrupt controller
- reg : Should contain 1 register range (address and length)
- interrupts-extended : Specifies which contexts are connected to the PLIC,
  with "-1" specifying that a context is not present.

Example:

	plic: interrupt-controller@c000000 {
		#address-cells = <0>;
		#interrupt-cells = <1>;
		compatible = "riscv,plic0";
		interrupt-controller;
		interrupts-extended = <
			&cpu0-intc 11
			&cpu1-intc 11 &cpu1-intc 9
			&cpu2-intc 11 &cpu2-intc 9
			&cpu3-intc 11 &cpu3-intc 9
			&cpu4-intc 11 &cpu4-intc 9>;
		reg = <0xc000000 0x4000000>;
		riscv,ndev = <10>;
	};
```

## Documentation/devicetree/bindings/nvmem/sifive-u500-otp.txt
```
= SiFive U500 OTP controller device tree bindings =

This binding represents the OTP controller found in U500 SoCs.

!!! EXERCISE EXTREME CAUTION USING THIS DEVICE  !!!

OTP bits can only be programmed once from 1 to 0. They are contained in the
chip itself. Incorrectly modifying OTP contents may require a new chip.

Required properties:
- compatible: should be "sifive,ememoryotp0"
- reg: Should contain registers location and length

For example:

	otp: sifive,ememoryotp0 {
		compatible = "sifive,ememoryotp0";
		reg = <0x0 0x10070000 0x0 0x1000>;
	};
```

## Documentation/devicetree/bindings/pwm/pwm-sifive.txt
```
SiFive PWM controller

Unlike most other PWM controllers, the SiFive PWM controller currently only
supports one period for all channels in the PWM. This is set globally in DTS.
The period also has significant restrictions on the values it can achieve,
which the driver rounds to the nearest achievable frequency.

Required properties:
- compatible: should be "sifive,pwm0"
- reg: physical base address and length of the controller's registers
- clocks: The frequency the controller runs at
- #pwm-cells: Should be 2.
  The first cell is the PWM channel number
  The second cell is the PWM polarity
- sifive,approx-period: the driver will get as close to this period as it can
- interrupts: one interrupt per PWM channel (currently unused in the driver)

Examples:

pwm:  pwm@10020000 {
	compatible = "sifive,pwm0";
	reg = <0x0 0x10020000 0x0 0x1000>;
	clocks = <&tlclk>;
	interrupt-parent = <&plic>;
	interrupts = <42 43 44 45>;
	#pwm-cells = <2>;
	sifive,approx-period = <1000000>;
};
```

## Documentation/devicetree/bindings/spi/spi-sifive.txt
```
SiFive SPI controller Device Tree Bindings
-------------------------------------------------

Required properties:
- compatible		: Should be "sifive,spi0"
- reg			: Physical base address and size of SPI registers map
			  A second (optional) range can indicate memory mapped flash
- interrupts		: Must contain one entry
- interrupt-parent	: Must be core interrupt controller
- clocks		: Must reference the frequency given to the controller
- #address-cells	: Must be '1', indicating which CS to use
- #size-cells		: Must be '0'

Optional properties:
- sifive,buffer-size	: Depth of hardware queues; defaults to 8
- sifive,bits-per-word	: Maximum bits per word; defaults to 8

Example:
	spi: spi@10040000 {
		compatible = "sifive,spi0";
		reg = <0x0 0x10040000 0x0 0x1000 0x0 0x20000000 0x0 0x10000000>;
		interrupt-parent = <&plic>;
		interrupts = <51>;
		clocks = <&tlclk>;
		#address-cells = <1>;
		#size-cells = <0>;
		sifive,buffer-size = <8>;
		sifive,bits-per-word = <8>;
	};
```
